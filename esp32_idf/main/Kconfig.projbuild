## esp32_idf/main/Kconfig.projbuild
```kconfig
menu "Example Configuration"

    config ESP_WIFI_SSID
        string "Plymouth Loco Works"
        default "esp32_ssid"
        help
            SSID (network name) to set up the softAP with.

    config ESP_WIFI_PASSWORD
        string ""
        default "esp32_pwd"
        help
            WiFi password (WPA or WPA2) for the example to use for the softAP.

    config ESP_MAX_STA_CONN
        int "Maximal STA connections"
        default 1
        help
            Max number of the STA connects to AP.
endmenu
```
